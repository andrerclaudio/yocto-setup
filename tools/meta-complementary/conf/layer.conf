## tools/meta-complementary/conf/layer.conf
```bitbake
# We have a conf and classes directory, add to BBPATH
BBPATH .= ":${LAYERDIR}"

# We have recipes-* directories, add to BBFILES
BBFILES += "${LAYERDIR}/recipes-*/*/*.bb \
            ${LAYERDIR}/recipes-*/*/*.bbappend"

BBFILE_COLLECTIONS += "meta-complementary"
BBFILE_PATTERN_meta-complementary = "^${LAYERDIR}/"
BBFILE_PRIORITY_meta-complementary = "6"

LAYERDEPENDS_meta-complementary = "core"
LAYERSERIES_COMPAT_meta-complementary = "scarthgap"
```
