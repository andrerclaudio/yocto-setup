## meta-board-nxp/conf/machine/imx8mn-lpddr4-evk.conf
```bitbake
#@TYPE: Machine
#@NAME: NXP i.MX 8M Nano Evaluation Kit with LPDDR4
#@SOC: i.MX8MN
#@DESCRIPTION: Machine configuration for NXP i.MX 8M Nano EVK with LPDDR4
#@MAINTAINER: Jun Zhu <junzhu@nxp.com>

MACHINEOVERRIDES =. "mx8mn:"

require conf/machine/include/imx-base.inc
require conf/machine/include/arm/armv8a/tune-cortexa53.inc

# The device tree name is implicit for LPDDR4, so can't use MACHINE here
KERNEL_DEVICETREE_BASENAME = "imx8mn-evk"
KERNEL_DEVICETREE = " \
    freescale/${KERNEL_DEVICETREE_BASENAME}.dtb \
"
UBOOT_DTB_NAME = "${KERNEL_DEVICETREE_BASENAME}.dtb"
UBOOT_CONFIG_BASENAME = "imx8mn_evk"
UBOOT_SUFFIX = "bin"
UBOOT_CONFIG ??= "sd"
UBOOT_CONFIG[sd]      = "${UBOOT_CONFIG_BASENAME}_defconfig,sdcard"
UBOOT_CONFIG[fspi]    = "${UBOOT_CONFIG_BASENAME}_defconfig"
UBOOT_CONFIG[ld]      = "${UBOOT_CONFIG_BASENAME}_ld_defconfig"

DDR_FIRMWARE_NAME = " \
    lpddr4_pmu_train_1d_imem.bin \
    lpddr4_pmu_train_1d_dmem.bin \
    lpddr4_pmu_train_2d_imem.bin \
    lpddr4_pmu_train_2d_dmem.bin \
"
IMXBOOT_TARGETS_BASENAME = "flash_evk"
IMX_DEFAULT_BOOTLOADER = "u-boot-imx"
IMX_DEFAULT_BSP = "nxp"

SPL_BINARY = "spl/u-boot-spl.bin"
ATF_PLATFORM = "imx8mn"
IMXBOOT_TARGETS = "${@bb.utils.contains('UBOOT_CONFIG', 'fspi', '${IMXBOOT_TARGETS_BASENAME}_flexspi', '${IMXBOOT_TARGETS_BASENAME}', d)}"

IMX_BOOT_SOC_TARGET = "iMX8MN"

SERIAL_CONSOLES = "115200;ttymxc1"

BOOT_SPACE = "65536"
LOADADDR = ""
UBOOT_MAKE_TARGET = "all"

# Image boot offset as defined in section 6.1.6.1 "Primary image offset and IVT offset" of
# i.MX 8M Nano Applications Processor Reference Manual, Rev. 0, 12/2019
# Doc ID: IMX8MNRM
IMX_BOOT_SEEK = "32"

OPTEE_BIN_EXT = "8mn"
TEE_LOAD_ADDR = "0x56000000"

# Add additional firmware
MACHINE_FIRMWARE:append = " linux-firmware-ath10k"

OPTEE_BOOT_IMAGE ?= "tee.bin"

# FIXME: Drop xxd if/when xxd-native can be used instead
HOSTTOOLS_NONFATAL:append = " xxd cert-to-efi-sig-list"

IMX_DEFAULT_UBOOTTOOLS = "u-boot-imx-tools"
PREFERRED_PROVIDER_u-boot-tools-native = "${IMX_DEFAULT_UBOOTTOOLS}-native"
PREFERRED_PROVIDER_nativesdk-u-boot-tools = "nativesdk-${IMX_DEFAULT_UBOOTTOOLS}"
PREFERRED_PROVIDER_u-boot-mkimage-native = "${IMX_DEFAULT_UBOOTTOOLS}-native"
PREFERRED_PROVIDER_nativesdk-u-boot-mkimage = "nativesdk-${IMX_DEFAULT_UBOOTTOOLS}"

PREFERRED_RPROVIDER_linux-firmware-bcm4359-pcie ??= "linux-firmware"
PREFERRED_RPROVIDER_linux-firmware-nxp9098-common ??= "linux-firmware"
PREFERRED_RPROVIDER_linux-firmware-nxp8997-common ??= "linux-firmware"
PREFERRED_RPROVIDER_u-boot-default-env ??= "${IMX_DEFAULT_BOOTLOADER}"
```

## meta-board-nxp/conf/machine/include/imx-base.inc
```bitbake
# Provides the i.MX common settings

include conf/machine/include/fsl-default-settings.inc
require conf/machine/include/utilities.inc

MACHINEOVERRIDES =. "use-${IMX_DEFAULT_BSP}-bsp:"

# UBOOT_BINARY is used inside the wks files to dynamically find the required
# U-Boot file.
UBOOT_BINARY ?= "u-boot.${UBOOT_SUFFIX}"

PREFERRED_PROVIDER_u-boot ??= "${IMX_DEFAULT_BOOTLOADER}"
PREFERRED_PROVIDER_u-boot-mfgtool ??= "${IMX_DEFAULT_BOOTLOADER}"
PREFERRED_PROVIDER_virtual/bootloader ??= "${IMX_DEFAULT_BOOTLOADER}"
IMX_DEFAULT_UBOOTTOOLS = "u-boot-imx-tools"
PREFERRED_PROVIDER_u-boot-mkimage-native = "${IMX_DEFAULT_UBOOTTOOLS}-native"
PREFERRED_PROVIDER_u-boot-mxsboot-native ??= "${IMX_DEFAULT_UBOOTTOOLS}-native"

UBOOT_ENTRYPOINT ?= "0x40480000"

IMX_DEFAULT_ATF_PROVIDER ??= "imx-atf"
SOC_ATF_BOOT_UART_BASE = "0x30890000"
ATF_BOOT_UART_BASE ?= "${SOC_ATF_BOOT_UART_BASE}"

# Ship kernel modules
MACHINE_EXTRA_RRECOMMENDS = "kernel-modules"

DEFAULTTUNE ?= "cortexa53-crypto"

INHERIT += "machine-overrides-extender"

IMX_SOC_REV ??= "A0"

IMX_SOC_REV_LOWER = "${@d.getVar('IMX_SOC_REV').lower()}"
IMX_SOC_REV_UPPER = "${@d.getVar('IMX_SOC_REV').upper()}"

#######
### NXP BSP specific overrides
#######
MACHINEOVERRIDES_EXTENDER:mx8mn:use-nxp-bsp  = "imx-generic-bsp:imx-nxp-bsp:imxdrm:imxgpu:imxgpu3d:imxvulkan:mx8-generic-bsp:mx8-nxp-bsp:mx8m-generic-bsp:mx8m-nxp-bsp:mx8mn-generic-bsp:mx8mn-nxp-bsp"
MACHINEOVERRIDES_EXTENDER_FILTER_OUT = " \
    mx8 \
    mx8m \
    mx8mn \
"

MACHINEOVERRIDES_FILTERED_OUT_QA_ERROR = "%s overrides cannot be used and need conversion to use the new BSP-specific overrides. Check 'meta-freescale/scripts/convert-bsp-specific-overrides'."

# Sub-architecture support
MACHINE_SOCARCH_SUFFIX = "-mx8mn"

MACHINE_ARCH_FILTER = "virtual/kernel"

INHERIT += "fsl-dynamic-packagearch"

# Firmware used for boot.
IMX_EXTRA_FIRMWARE ?= ""

# Handle default kernel
IMX_DEFAULT_KERNEL = "linux-mainline"

PREFERRED_PROVIDER_virtual/kernel ??= "${IMX_DEFAULT_KERNEL}"

SOC_DEFAULT_IMAGE_FSTYPES = "wic.bmap wic.gz wic.zst"

# Do not update fstab file when using wic images
WIC_CREATE_EXTRA_ARGS ?= "--no-fstab-update"

IMAGE_FSTYPES ?= "${SOC_DEFAULT_IMAGE_FSTYPES}"

IMAGE_BOOT_FILES ?= " \
    ${KERNEL_IMAGETYPE} \
    ${@make_dtb_boot_files(d)} \
"

WKS_FILE_DEPENDS ?= " \
    virtual/bootloader \
    \
    e2fsprogs-native \
    bmap-tools-native \
"

WKS_FILE_DEPENDS:append:aarch64 = "imx-boot"

SOC_DEFAULT_WKS_FILE ?= "imx-uboot-bootpart.wks.in"

WKS_FILE ?= "${SOC_DEFAULT_WKS_FILE}"

SERIAL_CONSOLES = "115200;ttymxc0"

KERNEL_IMAGETYPE = "zImage"
KERNEL_IMAGETYPE:aarch64 = "Image"

HOSTTOOLS_NONFATAL = " sha384sum"

# Add task to generate the mfgtool bundle for the image.
IMAGE_CLASSES += "image_types_fsl"
IMAGE_CLASSES:append = " image_populate_mfgtool"

# Allow meta-imx to add NIP devices information until upstreamed.
include conf/machine/include/imx-base-extend.inc
```

## meta-board-nxp/conf/machine/nxp-imx8mn.conf
```bitbake
#@TYPE: Machine
#@NAME: NXP i.MX 8M Nano Evaluation Kit with LPDDR4
#@SOC: i.MX8MN
#@DESCRIPTION: Machine configuration for NXP i.MX 8M Nano EVK with LPDDR4

MACHINEOVERRIDES =. "mx8mn:"

require conf/machine/include/imx-base.inc
require conf/machine/include/arm/armv8a/tune-cortexa53.inc

# The device tree name is implicit for LPDDR4, so can't use MACHINE here
KERNEL_DEVICETREE_BASENAME = "imx8mn-evk"

KERNEL_DEVICETREE = " \
	freescale/${KERNEL_DEVICETREE_BASENAME}.dtb \
    freescale/${KERNEL_DEVICETREE_BASENAME}-8mic-revE.dtb \
    freescale/${KERNEL_DEVICETREE_BASENAME}-ak5558.dtb \
	freescale/${KERNEL_DEVICETREE_BASENAME}-inmate.dtb \
	freescale/${KERNEL_DEVICETREE_BASENAME}-rm67191.dtb \
	freescale/${KERNEL_DEVICETREE_BASENAME}-root.dtb \
	freescale/${KERNEL_DEVICETREE_BASENAME}-rpmsg.dtb \ 
"

UBOOT_CONFIG_BASENAME = "imx8mn_evk"
DDR_FIRMWARE_NAME = " \
    lpddr4_pmu_train_1d_imem.bin \
    lpddr4_pmu_train_1d_dmem.bin \
    lpddr4_pmu_train_2d_imem.bin \
    lpddr4_pmu_train_2d_dmem.bin \
"
IMXBOOT_TARGETS_BASENAME = "flash_evk"

# Mainline BSP doesn't support LPDDR4 so it must be set to nxp.
# Also this machine isn't supported by u-boot-fslc but imx8mn-evk.inc already
# set the bootloader to u-boot-imx instead when NXP BSP is used.
IMX_DEFAULT_BSP = "nxp"

MACHINE_FEATURES += "wifi bluetooth bcm43455 bcm4356 bcm4359 optee"
UBOOT_DTB_NAME = "${KERNEL_DEVICETREE_BASENAME}.dtb"
IMX_DEFAULT_BOOTLOADER = "u-boot-imx"
UBOOT_SUFFIX = "bin"
UBOOT_CONFIG ??= "sd"
UBOOT_CONFIG[sd]      = "${UBOOT_CONFIG_BASENAME}_defconfig,sdcard"
UBOOT_CONFIG[fspi]    = "${UBOOT_CONFIG_BASENAME}_defconfig"
UBOOT_CONFIG[ld]      = "${UBOOT_CONFIG_BASENAME}_ld_defconfig"
UBOOT_CONFIG[mfgtool] = "${UBOOT_CONFIG_BASENAME}_defconfig"

SPL_BINARY = "spl/u-boot-spl.bin"
ATF_PLATFORM = "imx8mn"
IMXBOOT_TARGETS = "${@bb.utils.contains('UBOOT_CONFIG', 'fspi', '${IMXBOOT_TARGETS_BASENAME}_flexspi', '${IMXBOOT_TARGETS_BASENAME}', d)}"
IMX_BOOT_SOC_TARGET = "iMX8MN"

SERIAL_CONSOLES = "115200;ttymxc1"

BOOT_SPACE = "65536"
LOADADDR = ""
UBOOT_MAKE_TARGET = "all"

# Image boot offset as defined in section 6.1.6.1 "Primary image offset and IVT offset" of
# i.MX 8M Nano Applications Processor Reference Manual, Rev. 0, 12/2019
# Doc ID: IMX8MNRM
IMX_BOOT_SEEK = "32"

OPTEE_BIN_EXT = "8mn"
TEE_LOAD_ADDR = "0x56000000"

# Add additional firmware
MACHINE_FIRMWARE:append = " linux-firmware-ath10k"
```

## meta-boards-nxp/conf/distro/nxp-custom.conf
```bitbake
# This is an example distro conf. Here is where you can customize the
# policies about how your embedded Linux system should be
# configured.

require conf/distro/fsl-imx-wayland.conf
DISTROOVERRIDES = "fsl-imx-wayland"

DISTRO_NAME = "NXP Custom Distro, Linux"
DISTRO = "nxp-custom"
DISTRO_VERSION = "1.0"

# Set features we want on all NXP devices. Also disables any features not
# explicitly mentioned.
DISTRO_FEATURES = " \
                    ipv4 \
                    ipv6 \
                    systemd \
                    usbgadget \
                    usbhost \
                    wifi \
                    zeroconf \
                "

# Set Systemd as Init manager software
INIT_MANAGER = "systemd"
```

## meta-boards-nxp/conf/layer.conf
```bitbake
# We have a conf and classes directory, add to BBPATH
BBPATH .= ":${LAYERDIR}"

# We have recipes-* directories, add to BBFILES
BBFILES += "${LAYERDIR}/recipes-*/*/*.bb \
            ${LAYERDIR}/recipes-*/*/*.bbappend"

BBFILE_COLLECTIONS += "meta-boards-nxp"
BBFILE_PATTERN_meta-boards-nxp = "^${LAYERDIR}/"
BBFILE_PRIORITY_meta-boards-nxp = "9"

LAYERDEPENDS_meta-boards-nxp = "core"
LAYERSERIES_COMPAT_meta-boards-nxp = "kirkstone"
```

## meta-nxp/conf/layer.conf
```bitbake
# We have a conf and classes directory, add to BBPATH
BBPATH .= ":${LAYERDIR}"

# We have recipes-* directories, add to BBFILES
BBFILES += "${LAYERDIR}/recipes-*/*/*.bb \
            ${LAYERDIR}/recipes-*/*/*.bbappend"

BBFILE_COLLECTIONS += "meta-nxp"
BBFILE_PATTERN_meta-nxp = "^${LAYERDIR}/"
BBFILE_PRIORITY_meta-nxp = "9"

LAYERDEPENDS_meta-nxp = "core"
LAYERSERIES_COMPAT_meta-nxp = "mickledore"
```

## meta-nxp/conf/machine/imx8mn-lpddr4-evk.conf
```bitbake
# Machine configuration for the imx8mn-lpddr4-evk board.
#

require include/common.inc
```

## meta-tools/conf/layer.conf
```bitbake
# We have a conf and classes directory, add to BBPATH
BBPATH .= ":${LAYERDIR}"

# We have recipes-* directories, add to BBFILES
BBFILES += "${LAYERDIR}/recipes-*/*/*.bb \
            ${LAYERDIR}/recipes-*/*/*.bbappend"

BBFILE_COLLECTIONS += "meta-tools"
BBFILE_PATTERN_meta-tools = "^${LAYERDIR}/"
BBFILE_PRIORITY_meta-tools = "9"

LAYERDEPENDS_meta-tools = "core"
LAYERSERIES_COMPAT_meta-tools = "mickledore"
```
