## NXP/meta-board-nxp/conf/distro/nxp-custom.conf
```bitbake
# This is a base configuration file for NXP boards.
include conf/distro/include/fsl-imx-base.inc
include conf/distro/include/fsl-imx-preferred-env.inc

DISTRO_NAME = "NXP Custom Distro, Linux"
DISTRO = "nxp-custom"
DISTRO_VERSION:append = " [1.0]"
MAINTAINER = "Andre Ribeiro <andre.ribeiro.srs@gmail.com>"


# Set features we want on all NXP devices. Also disables any features not
# explicitly mentioned.
DISTRO_FEATURES = " \
                    ipv4 \
                    ipv6 \
                    systemd \
                    usbgadget \
                    usbhost \
                    wifi \
                    zeroconf \
                    en-us-locale \
                "

# Remove conflicting backends
DISTRO_FEATURES:remove = "directfb x11 wayland "

# Set Systemd as Init manager software
INIT_MANAGER = "systemd"

# Remove TAR artifact to improve bitbake time and download speed
SOC_DEFAULT_IMAGE_FSTYPES:remove = " tar.zst"
```

## NXP/meta-board-nxp/conf/layer.conf
```bitbake
# We have a conf and classes directory, add to BBPATH
BBPATH .= ":${LAYERDIR}"

# We have recipes-* directories, add to BBFILES
BBFILES += "${LAYERDIR}/recipes-*/*/*.bb \
            ${LAYERDIR}/recipes-*/*/*.bbappend"

BBFILE_COLLECTIONS += "meta-board-nxp"
BBFILE_PATTERN_meta-board-nxp = "^${LAYERDIR}/"
BBFILE_PRIORITY_meta-board-nxp = "5"

LAYERDEPENDS_meta-board-nxp = "core"
LAYERSERIES_COMPAT_meta-board-nxp = "mickledore"

# Define new EULAs and add them to the list defined in meta-freescale.
# See fsl-eula-unpack.bbclass.
FSL_EULA_FILE_MD5SUM_LA_OPT_NXP_SOFTWARE_LICENSE_V49 = "2827219e81f28aba7c6a569f7c437fa7"

FSL_EULA_FILE_MD5SUMS:append = " \
    ${FSL_EULA_FILE_MD5SUM_LA_OPT_NXP_SOFTWARE_LICENSE_V49} \
"

# Override the EULA defined in meta-freescale.
FSL_EULA_FILE = "${LAYERDIR}/LICENSE.txt"
FSL_EULA_FILE_MD5SUM = "${FSL_EULA_FILE_MD5SUM_LA_OPT_NXP_SOFTWARE_LICENSE_V49}"
```

## NXP/meta-disabled-uart3/conf/layer.conf
```bitbake
# We have a conf and classes directory, add to BBPATH
BBPATH .= ":${LAYERDIR}"

# We have recipes-* directories, add to BBFILES
BBFILES += "${LAYERDIR}/recipes-*/*/*.bb \
            ${LAYERDIR}/recipes-*/*/*.bbappend"

BBFILE_COLLECTIONS += "meta-disabled-uart3"
BBFILE_PATTERN_meta-disabled-uart3 = "^${LAYERDIR}/"
BBFILE_PRIORITY_meta-disabled-uart3 = "6"

LAYERDEPENDS_meta-disabled-uart3 = "core"
LAYERSERIES_COMPAT_meta-disabled-uart3 = "scarthgap"
```

## NXP/meta-imx8mnevk-custom/conf/distro/nxp-custom.conf
```bitbake
# This is a base configuration file for NXP boards.
include conf/distro/include/fsl-imx-base.inc
include conf/distro/include/fsl-imx-preferred-env.inc

DISTRO_NAME                         = "NXP Custom Distro, Linux"
DISTRO                              = "nxp-custom"
DISTRO_VERSION                     += "v1.1"
MAINTAINER                          = "Andre Ribeiro <andre.ribeiro.srs@gmail.com>"


# Set features we want on all NXP devices. Also disables any features not
# explicitly mentioned.
DISTRO_FEATURES                     = " \
                                        alsa \
                                        en-us-locale \
                                        ipv4 \
                                        ipv6 \
                                        pulseaudio \
                                        usbgadget \
                                        usbhost \
                                        wifi \
                                        zeroconf \
                                        \
                                    "           

# Remove conflicting backends
DISTRO_FEATURES:remove              = "directfb x11 wayland "

# Disabling sysvinit and Enabling systemd
DISTRO_FEATURES:append                      =   " systemd usrmerge"
DISTRO_FEATURES_BACKFILL_CONSIDERED         +=  "sysvinit"
VIRTUAL-RUNTIME_init_manager                =   "systemd"
VIRTUAL-RUNTIME_initscripts                 =   "systemd-compat-units"

# Remove TAR artifact to improve bitbake time and download speed
SOC_DEFAULT_IMAGE_FSTYPES:remove    = " tar.zst"
```

## NXP/meta-imx8mnevk-custom/conf/layer.conf
```bitbake
# We have a conf and classes directory, add to BBPATH
BBPATH .= ":${LAYERDIR}"

# We have recipes-* directories, add to BBFILES
BBFILES += "${LAYERDIR}/recipes-*/*/*.bb \
            ${LAYERDIR}/recipes-*/*/*.bbappend"

BBFILE_COLLECTIONS += "meta-imx8mnevk-custom"
BBFILE_PATTERN_meta-imx8mnevk-custom = "^${LAYERDIR}/"
BBFILE_PRIORITY_meta-imx8mnevk-custom = "5"

LAYERDEPENDS_meta-imx8mnevk-custom = "core"
LAYERSERIES_COMPAT_meta-imx8mnevk-custom = "scarthgap"
```

## NXP/meta-wifi-mlan0/conf/layer.conf
```bitbake
# We have a conf and classes directory, add to BBPATH
BBPATH .= ":${LAYERDIR}"

# We have recipes-* directories, add to BBFILES
BBFILES += "${LAYERDIR}/recipes-*/*/*.bb \
            ${LAYERDIR}/recipes-*/*/*.bbappend"

BBFILE_COLLECTIONS += "meta-wifi-mlan0"
BBFILE_PATTERN_meta-wifi-mlan0 = "^${LAYERDIR}/"
BBFILE_PRIORITY_meta-wifi-mlan0 = "6"

LAYERDEPENDS_meta-wifi-mlan0 = "core"
LAYERSERIES_COMPAT_meta-wifi-mlan0 = "scarthgap"
```

## NXP/meta-wireless-nxp/conf/layer.conf
```bitbake
# We have a conf and classes directory, add to BBPATH
BBPATH .= ":${LAYERDIR}"

# We have recipes-* directories, add to BBFILES
BBFILES += "${LAYERDIR}/recipes-*/*/*.bb \
            ${LAYERDIR}/recipes-*/*/*.bbappend"

BBFILE_COLLECTIONS += "meta-wireless-nxp"
BBFILE_PATTERN_meta-wireless-nxp = "^${LAYERDIR}/"
BBFILE_PRIORITY_meta-wireless-nxp = "6"

LAYERDEPENDS_meta-wireless-nxp = "core"
LAYERSERIES_COMPAT_meta-wireless-nxp = "mickledore scarthgap nanbield"
```

## Raspberry/meta-board-rasp/conf/distro/rasp-custom.conf
```bitbake
DISTRO_NAME                         = "Raspberry PI Custom Distro, Linux"
DISTRO                              = "rasp-custom"
DISTRO_VERSION                     += "v1.0"
MAINTAINER                          = "Andre Ribeiro <andre.ribeiro.srs@gmail.com>"


# Set features we want on all NXP devices. Also disables any features not
# explicitly mentioned.
DISTRO_FEATURES                     = " \
                                        en-us-locale \
                                        ipv4 \
                                        ipv6 \
                                        systemd \
                                        usbgadget \
                                        usbhost \
                                        wifi \
                                        zeroconf \
                                        \
                                    "           

# Set Systemd as Init manager software
INIT_MANAGER                        = "systemd"

# Remove TAR artifact to improve bitbake time and download speed
# SOC_DEFAULT_IMAGE_FSTYPES:remove    = " tar.zst"
```

## Raspberry/meta-board-rasp/conf/layer.conf
```bitbake
# We have a conf and classes directory, add to BBPATH
BBPATH .= ":${LAYERDIR}"

# We have recipes-* directories, add to BBFILES
BBFILES += "${LAYERDIR}/recipes-*/*/*.bb \
            ${LAYERDIR}/recipes-*/*/*.bbappend"

BBFILE_COLLECTIONS += "meta-board-rasp"
BBFILE_PATTERN_meta-board-rasp = "^${LAYERDIR}/"
BBFILE_PRIORITY_meta-board-rasp = "5"

LAYERDEPENDS_meta-board-rasp = "core"
LAYERSERIES_COMPAT_meta-board-rasp = "scarthgap"
```

## Raspberry/meta-rasp-custom/conf/distro/rasp-custom.conf
```bitbake
DISTRO_NAME                         = "Raspberry PI Custom Distro, Linux"
DISTRO                              = "rasp-custom"
DISTRO_VERSION                      = "v1.0.1"
MAINTAINER                          = "Andre Ribeiro <andre.ribeiro.srs@gmail.com>"


# Set features we want on all Raspberry devices. Also disables any features not
# explicitly mentioned.
DISTRO_FEATURES                     = " \
                                        en-us-locale \
                                        ipv4 \
                                        ipv6 \
                                        usbgadget \
                                        usbhost \
                                        wifi \
                                        zeroconf \
                                        \
                                    "

# Set machine Hostname
hostname:pn-base-files = "raspberry"

# Disable logo on boot
DISABLE_RPI_BOOT_LOGO = "1"

RPI_EXTRA_CONFIG = ' \n\
# Disable bluetooth\n\
dtoverlay=pi3-disable-bt\n\
# Enable Uart on ttyAMA0\n\
enable_uart=1\n\
'
# Disable Uart console on ttyAMA0
CMDLINE:append = ' console=tty1'

# Set ROOT_HOME to "/root" to avoid warnings.
ROOT_HOME = '/root'

# Disabling sysvinit and Enabling systemd
DISTRO_FEATURES:append                  =   " systemd usrmerge"
DISTRO_FEATURES_BACKFILL_CONSIDERED     +=  "sysvinit"
VIRTUAL-RUNTIME_init_manager            =   "systemd"
VIRTUAL-RUNTIME_initscripts             =   "systemd-compat-units"
```

## Raspberry/meta-rasp-custom/conf/layer.conf
```bitbake
# We have a conf and classes directory, add to BBPATH
BBPATH .= ":${LAYERDIR}"

# We have recipes-* directories, add to BBFILES
BBFILES += "${LAYERDIR}/recipes-*/*/*.bb \
            ${LAYERDIR}/recipes-*/*/*.bbappend"

BBFILE_COLLECTIONS += "meta-rasp-custom"
BBFILE_PATTERN_meta-rasp-custom = "^${LAYERDIR}/"
BBFILE_PRIORITY_meta-rasp-custom = "5"

LAYERDEPENDS_meta-rasp-custom = "core"
LAYERSERIES_COMPAT_meta-rasp-custom = "scarthgap"
```

## ST/meta-board-st/conf/distro/st-custom.conf
```bitbake
# =========================================================================
# Enable uninative support
# =========================================================================
# require conf/distro/include/no-static-libs.inc
# require conf/distro/include/yocto-uninative.inc
# INHERIT += "uninative"

# Set common distrooverrides for all ST distro
DISTROOVERRIDES =. "openstlinuxcommon:"

DISTRO_NAME                         = "ST Custom Distro, Linux"
DISTRO                              = "st-custom"
DISTRO_VERSION                      = "v1.0"
MAINTAINER                          = "Andre Ribeiro <andre.ribeiro.srs@gmail.com>"

#--------------------------
# Tune build config display
#
BUILDCFG_VARS += "DISTRO_CODENAME"
BUILDCFG_VARS += "${@'ACCEPT_EULA_' + d.getVar('MACHINE')}"
BUILDCFG_VARS += "GCCVERSION"
BUILDCFG_VARS += "PREFERRED_PROVIDER_virtual/kernel"

# Append distro name to each image name
IMAGE_BASENAME:append = "-${DISTRO}"

# =========================================================================
# DISTRO features
# =========================================================================
DISTRO_FEATURES                     = " \
                                        en-us-locale \
                                        gstreamer \
                                        ipv4 \
                                        ipv6 \
                                        optee \
                                        opengl \
                                        pam \
                                        systemd \
                                        usbgadget \
                                        usbhost \
                                        wayland \
                                        wifi \
                                        zeroconf \
                                        \
                                    "    

# Disabling sysvinit
DISTRO_FEATURES_BACKFILL_CONSIDERED         += "sysvinit"
VIRTUAL-RUNTIME_init_manager                = "systemd"
VIRTUAL-RUNTIME_initscripts                 = "systemd-compat-units"

LICENSE_FLAGS_ACCEPTED += " non-commercial commercial"


# WKS_IMAGE_FSTYPES += "wic wic.bz2 wic.bmap"
# WKS_FILE += "${OPTEE_WIC_FILE}"
IMAGE_FSTYPES:remove = " tar.xz"
```

## ST/meta-board-st/conf/layer.conf
```bitbake
# We have a conf and classes directory, add to BBPATH
BBPATH .= ":${LAYERDIR}"

# We have recipes-* directories, add to BBFILES
BBFILES += "${LAYERDIR}/recipes-*/*/*.bb \
            ${LAYERDIR}/recipes-*/*/*.bbappend"

BBFILE_COLLECTIONS += "meta-board-st"
BBFILE_PATTERN_meta-board-st = "^${LAYERDIR}/"
BBFILE_PRIORITY_meta-board-st = "5"

LAYERDEPENDS_meta-board-st = "core"
LAYERSERIES_COMPAT_meta-board-st = "mickledore"
```

## ST/meta-experience/conf/layer.conf
```bitbake
# We have a conf and classes directory, add to BBPATH
BBPATH .= ":${LAYERDIR}"

# We have recipes-* directories, add to BBFILES
BBFILES += "${LAYERDIR}/recipes-*/*/*.bb \
            ${LAYERDIR}/recipes-*/*/*.bbappend"

BBFILE_COLLECTIONS += "meta-experience"
BBFILE_PATTERN_meta-experience = "^${LAYERDIR}/"
BBFILE_PRIORITY_meta-experience = "6"

LAYERDEPENDS_meta-experience = "core"
LAYERSERIES_COMPAT_meta-experience = "mickledore"
```

## ST/meta-stm32mp13-custom/conf/layer.conf
```bitbake
# We have a conf and classes directory, add to BBPATH
BBPATH .= ":${LAYERDIR}"

# We have recipes-* directories, add to BBFILES
BBFILES += "${LAYERDIR}/recipes-*/*/*.bb \
            ${LAYERDIR}/recipes-*/*/*.bbappend"

BBFILE_COLLECTIONS += "meta-stm32mp13-custom"
BBFILE_PATTERN_meta-stm32mp13-custom = "^${LAYERDIR}/"
BBFILE_PRIORITY_meta-stm32mp13-custom = "5"

LAYERDEPENDS_meta-stm32mp13-custom = "core"
LAYERSERIES_COMPAT_meta-stm32mp13-custom = "mickledore"
```

## ST/meta-wireless-st/conf/layer.conf
```bitbake
# We have a conf and classes directory, add to BBPATH
BBPATH .= ":${LAYERDIR}"

# We have recipes-* directories, add to BBFILES
BBFILES += "${LAYERDIR}/recipes-*/*/*.bb \
            ${LAYERDIR}/recipes-*/*/*.bbappend"

BBFILE_COLLECTIONS += "meta-wireless-st"
BBFILE_PATTERN_meta-wireless-st = "^${LAYERDIR}/"
BBFILE_PRIORITY_meta-wireless-st = "6"

LAYERDEPENDS_meta-wireless-st = "core"
LAYERSERIES_COMPAT_meta-wireless-st = "mickledore"
```

## meta-board-nxp/conf/layer.conf
```bitbake
# We have a conf and classes directory, add to BBPATH
BBPATH .= ":${LAYERDIR}"

# We have recipes-* directories, add to BBFILES
BBFILES += "${LAYERDIR}/recipes-*/*/*.bb \
            ${LAYERDIR}/recipes-*/*/*.bbappend"

BBFILE_COLLECTIONS += "meta-board-nxp"
BBFILE_PATTERN_meta-board-nxp = "^${LAYERDIR}/"
BBFILE_PRIORITY_meta-board-nxp = "5"

LAYERDEPENDS_meta-board-nxp = "core"
LAYERSERIES_COMPAT_meta-board-nxp = "mickledore"

# Add the Freescale-specific licenses into the metadata
LICENSE_PATH += "${LAYERDIR}/custom-licenses"

FSL_EULA_FILE = "${LAYERDIR}/EULA"

IMX_MIRROR ?= "https://www.nxp.com/lgfiles/NMG/MAD/YOCTO/"

# FIXME: set this to avoid changing all the recipes that use it
FSL_MIRROR ?= "${IMX_MIRROR}"

MIRRORS += " \
${IMX_MIRROR}   http://download.ossystems.com.br/bsp/freescale/source/ \n \
"

# Define new EULAs and add them to the list defined in meta-freescale.
# See fsl-eula-unpack.bbclass.
FSL_EULA_FILE_MD5SUM_LA_OPT_NXP_SOFTWARE_LICENSE_V44 = "d7853b7bf2936b2c25c893eac7033374"
FSL_EULA_FILE_MD5SUM_LA_OPT_NXP_SOFTWARE_LICENSE_V45 = "63a38e9f392d8813d6f1f4d0d6fbe657"
FSL_EULA_FILE_MD5SUM_LA_OPT_NXP_SOFTWARE_LICENSE_V46 = "673fa34349fa40f59e0713cb0ac22b1f"
FSL_EULA_FILE_MD5SUM_LA_OPT_NXP_SOFTWARE_LICENSE_V47 = "9135422c7a38dac21bf1f858b6ef3bac"
FSL_EULA_FILE_MD5SUM_LA_OPT_NXP_SOFTWARE_LICENSE_V48 = "db4762b09b6bda63da103963e6e081de"
FSL_EULA_FILE_MD5SUM_LA_OPT_NXP_SOFTWARE_LICENSE_V49 = "2827219e81f28aba7c6a569f7c437fa7"

FSL_EULA_FILE_MD5SUMS:append = " \
    ${FSL_EULA_FILE_MD5SUM_LA_OPT_NXP_SOFTWARE_LICENSE_V44} \
    ${FSL_EULA_FILE_MD5SUM_LA_OPT_NXP_SOFTWARE_LICENSE_V45} \
    ${FSL_EULA_FILE_MD5SUM_LA_OPT_NXP_SOFTWARE_LICENSE_V46} \
    ${FSL_EULA_FILE_MD5SUM_LA_OPT_NXP_SOFTWARE_LICENSE_V47} \
    ${FSL_EULA_FILE_MD5SUM_LA_OPT_NXP_SOFTWARE_LICENSE_V48} \
    ${FSL_EULA_FILE_MD5SUM_LA_OPT_NXP_SOFTWARE_LICENSE_V49} \
"

# Override the EULA defined in meta-freescale.
FSL_EULA_FILE = "${LAYERDIR}/LICENSE.txt"
FSL_EULA_FILE_MD5SUM = "${FSL_EULA_FILE_MD5SUM_LA_OPT_NXP_SOFTWARE_LICENSE_V49}"
```
